## configs/imx6ull_debug_defconfig
```kconfig
BR2_arm=y
BR2_cortex_a7=y
BR2_ARM_FPU_NEON_VFPV4=y
BR2_PACKAGE_HOST_LINUX_HEADERS_CUSTOM_7_0=y
BR2_TOOLCHAIN_BUILDROOT_CXX=y
BR2_PACKAGE_HOST_GDB=y
BR2_PACKAGE_HOST_GDB_TUI=y
BR2_PACKAGE_HOST_GDB_PYTHON3=y
BR2_ENABLE_DEBUG=y
BR2_ENABLE_RUNTIME_DEBUG=y
# BR2_STRIP_strip is not set
BR2_OPTIMIZE_G=y
BR2_PACKAGE_OVERRIDE_FILE="$(BR2_EXTERNAL_LINUX_BSP_PATH)/board/freescale/imx6ull/local.mk"
BR2_DOWNLOAD_FORCE_CHECK_HASHES=y
BR2_TARGET_GENERIC_ISSUE=""
# BR2_TARGET_GENERIC_GETTY is not set
BR2_ROOTFS_OVERLAY="$(BR2_EXTERNAL_LINUX_BSP_PATH)/board/freescale/imx6ull/rootfs-overlay"
BR2_ROOTFS_POST_BUILD_SCRIPT="$(BR2_EXTERNAL_LINUX_BSP_PATH)/board/freescale/imx6ull/post-build.sh"
BR2_ROOTFS_POST_IMAGE_SCRIPT="$(BR2_EXTERNAL_LINUX_BSP_PATH)/board/freescale/imx6ull/post-image.sh"
BR2_LINUX_KERNEL=y
BR2_LINUX_KERNEL_CUSTOM_VERSION=y
BR2_LINUX_KERNEL_CUSTOM_VERSION_VALUE="7.0"
BR2_LINUX_KERNEL_USE_CUSTOM_CONFIG=y
BR2_LINUX_KERNEL_CUSTOM_CONFIG_FILE="$(BR2_EXTERNAL_LINUX_BSP_PATH)/board/freescale/imx6ull/linux_debug_defconfig"
BR2_LINUX_KERNEL_DTS_SUPPORT=y
BR2_LINUX_KERNEL_INTREE_DTS_NAME="nxp/imx/imx6ull-atk-dl6y2c"
BR2_LINUX_KERNEL_NEEDS_HOST_OPENSSL=y
BR2_PACKAGE_LINUX_TOOLS_GPIO=y
BR2_PACKAGE_LINUX_TOOLS_MM=y
BR2_PACKAGE_LINUX_TOOLS_PERF=y
BR2_PACKAGE_LINUX_TOOLS_PERF_TUI=y
BR2_PACKAGE_LINUX_TOOLS_PERF_NEEDS_HOST_PYTHON3=y
BR2_PACKAGE_BUSYBOX_CONFIG="$(BR2_EXTERNAL_LINUX_BSP_PATH)/board/freescale/imx6ull/busybox_defconfig"
# BR2_PACKAGE_URANDOM_SCRIPTS is not set
BR2_PACKAGE_BUSYBOX_SHOW_OTHERS=y
BR2_PACKAGE_GDB=y
BR2_PACKAGE_GDB_SERVER=y
BR2_PACKAGE_GDB_DEBUGGER=y
BR2_PACKAGE_GDB_TUI=y
BR2_PACKAGE_LTRACE=y
BR2_PACKAGE_STRACE=y
BR2_PACKAGE_STRESS_NG=y
BR2_PACKAGE_TRACE_CMD=y
BR2_PACKAGE_TREE=y
BR2_PACKAGE_FREESCALE_IMX=y
BR2_PACKAGE_FREESCALE_IMX_PLATFORM_IMX6UL=y
BR2_PACKAGE_FIRMWARE_IMX=y
BR2_PACKAGE_I2C_TOOLS=y
BR2_PACKAGE_MEMTESTER=y
BR2_PACKAGE_SYSSTAT=y
BR2_PACKAGE_ETHTOOL=y
BR2_PACKAGE_TCPDUMP=y
BR2_PACKAGE_FILE=y
BR2_PACKAGE_HTOP=y
BR2_PACKAGE_IPROUTE2=y
BR2_PACKAGE_CAN_UTILS=y
BR2_PACKAGE_KMOD=y
BR2_PACKAGE_PROCPS_NG=y
BR2_PACKAGE_PROCPS_NG_ORIGINAL_TOP=y
BR2_PACKAGE_UTIL_LINUX=y
BR2_PACKAGE_UTIL_LINUX_LIBBLKID=y
BR2_PACKAGE_LESS=y
BR2_PACKAGE_NANO=y
BR2_TARGET_ROOTFS_EXT2=y
BR2_TARGET_ROOTFS_EXT2_4=y
BR2_TARGET_ROOTFS_EXT2_SIZE="512M"
BR2_TARGET_UBOOT=y
BR2_TARGET_UBOOT_BUILD_SYSTEM_KCONFIG=y
BR2_TARGET_UBOOT_USE_CUSTOM_CONFIG=y
BR2_TARGET_UBOOT_CUSTOM_CONFIG_FILE="$(BR2_EXTERNAL_LINUX_BSP_PATH)/board/freescale/imx6ull/uboot_defconfig"
BR2_TARGET_UBOOT_CUSTOM_VERSION=y
BR2_TARGET_UBOOT_CUSTOM_VERSION_VALUE="u-boot-v2024.10"
BR2_TARGET_UBOOT_NEEDS_DTC=y
BR2_TARGET_UBOOT_NEEDS_OPENSSL=y
BR2_TARGET_UBOOT_NEEDS_GNUTLS=y
BR2_TARGET_UBOOT_FORMAT_DTB_IMX=y
BR2_PACKAGE_HOST_DOSFSTOOLS=y
BR2_PACKAGE_HOST_GENIMAGE=y
BR2_PACKAGE_HOST_MTOOLS=y
BR2_PACKAGE_PAF=y
BR2_PACKAGE_PAF_DEFCONFIG="imx6ull_debug_defconfig"
BR2_PACKAGE_PAF_PDI_BMC_REDFISH=y
BR2_PACKAGE_PAF_PDI_BMC_IPMI=y
BR2_PACKAGE_PAF_TB_MQTT_PUB=y
# BR2_PACKAGE_MOSQUITTO_CLIENTS is not set
# BR2_PACKAGE_MOSQUITTO_APPS is not set
# BR2_PACKAGE_MOSQUITTO_BROKER is not set
```

## configs/imx6ull_sdk_defconfig
```kconfig
BR2_arm=y
BR2_cortex_a7=y
BR2_ARM_FPU_NEON_VFPV4=y
BR2_TOOLCHAIN_BUILDROOT_VENDOR="cortex_a7"
BR2_PACKAGE_HOST_LINUX_HEADERS_CUSTOM_7_0=y
BR2_TOOLCHAIN_BUILDROOT_CXX=y
BR2_GCC_ENABLE_OPENMP=y
BR2_DL_DIR="/opt/buildroot/download"
BR2_DOWNLOAD_FORCE_CHECK_HASHES=y
BR2_TARGET_GENERIC_HOSTNAME="imx6ull"
BR2_TARGET_GENERIC_ISSUE=""
BR2_INIT_NONE=y
# BR2_TARGET_ENABLE_ROOT_LOGIN is not set
BR2_LINUX_KERNEL=y
BR2_LINUX_KERNEL_CUSTOM_VERSION=y
BR2_LINUX_KERNEL_CUSTOM_VERSION_VALUE="7.0"
BR2_LINUX_KERNEL_USE_CUSTOM_CONFIG=y
BR2_LINUX_KERNEL_CUSTOM_CONFIG_FILE="$(BR2_EXTERNAL_IMX6ULL_PATH)/board/freescale/imx6ull-evk/linux_defconfig"
BR2_LINUX_KERNEL_DTS_SUPPORT=y
BR2_LINUX_KERNEL_INTREE_DTS_NAME="nxp/imx/imx6ull-14x14-evk"
BR2_LINUX_KERNEL_NEEDS_HOST_OPENSSL=y
# BR2_PACKAGE_BUSYBOX is not set
BR2_PACKAGE_DROPBEAR=y
# BR2_TARGET_ROOTFS_TAR is not set
BR2_PACKAGE_HOST_DOSFSTOOLS=y
BR2_PACKAGE_HOST_DTC=y
BR2_PACKAGE_HOST_GENIMAGE=y
BR2_PACKAGE_HOST_MTOOLS=y
```

## configs/imx6ullevk_defconfig
```kconfig
BR2_arm=y
BR2_cortex_a7=y
BR2_ARM_FPU_NEON_VFPV4=y
BR2_PACKAGE_HOST_LINUX_HEADERS_CUSTOM_7_0=y
BR2_PACKAGE_OVERRIDE_FILE="$(BR2_EXTERNAL_IMX6ULL_PATH)/board/freescale/imx6ull-evk/local.mk"
BR2_DOWNLOAD_FORCE_CHECK_HASHES=y
BR2_TARGET_GENERIC_ISSUE=""
# BR2_TARGET_GENERIC_GETTY is not set
BR2_ROOTFS_OVERLAY="$(BR2_EXTERNAL_IMX6ULL_PATH)/board/freescale/imx6ull-evk/rootfs-overlay"
BR2_ROOTFS_POST_IMAGE_SCRIPT="$(BR2_EXTERNAL_IMX6ULL_PATH)/board/freescale/imx6ull-evk/post-image.sh"
BR2_LINUX_KERNEL=y
BR2_LINUX_KERNEL_CUSTOM_VERSION=y
BR2_LINUX_KERNEL_CUSTOM_VERSION_VALUE="7.0"
BR2_LINUX_KERNEL_USE_CUSTOM_CONFIG=y
BR2_LINUX_KERNEL_CUSTOM_CONFIG_FILE="$(BR2_EXTERNAL_IMX6ULL_PATH)/board/freescale/imx6ull-evk/linux_defconfig"
BR2_LINUX_KERNEL_DTS_SUPPORT=y
BR2_LINUX_KERNEL_INTREE_DTS_NAME="nxp/imx/imx6ull-14x14-evk"
BR2_LINUX_KERNEL_NEEDS_HOST_OPENSSL=y
BR2_PACKAGE_BUSYBOX_CONFIG="$(BR2_EXTERNAL_IMX6ULL_PATH)/board/freescale/imx6ull-evk/busybox_defconfig"
BR2_PACKAGE_FREESCALE_IMX=y
BR2_PACKAGE_FREESCALE_IMX_PLATFORM_IMX6UL=y
BR2_PACKAGE_FIRMWARE_IMX=y
BR2_PACKAGE_KMOD=y
BR2_PACKAGE_UTIL_LINUX=y
BR2_PACKAGE_UTIL_LINUX_LIBBLKID=y
BR2_TARGET_ROOTFS_EXT2=y
BR2_TARGET_ROOTFS_EXT2_4=y
BR2_TARGET_ROOTFS_EXT2_SIZE="512M"
BR2_TARGET_UBOOT=y
BR2_TARGET_UBOOT_BOARDNAME="mx6ull_14x14_evk"
BR2_TARGET_UBOOT_CUSTOM_VERSION=y
BR2_TARGET_UBOOT_CUSTOM_VERSION_VALUE="u-boot-v2024.10"
BR2_TARGET_UBOOT_NEEDS_DTC=y
BR2_TARGET_UBOOT_NEEDS_OPENSSL=y
BR2_TARGET_UBOOT_NEEDS_GNUTLS=y
BR2_TARGET_UBOOT_FORMAT_DTB_IMX=y
BR2_PACKAGE_HOST_DOSFSTOOLS=y
BR2_PACKAGE_HOST_GENIMAGE=y
BR2_PACKAGE_HOST_MTOOLS=y
BR2_PACKAGE_LPF=y
BR2_PACKAGE_LPF_DEFCONFIG="imx6ull_modules_defconfig"
```

## configs/ti_am62x_defconfig
```kconfig
BR2_aarch64=y
BR2_TOOLCHAIN_EXTERNAL=y
BR2_TOOLCHAIN_EXTERNAL_CUSTOM=y
BR2_TOOLCHAIN_EXTERNAL_PATH="/opt/buildroot/aarch64-ca53-linux-gnu_sdk-buildroot"
BR2_TOOLCHAIN_EXTERNAL_CUSTOM_PREFIX="$(ARCH)-ca53-linux-gnu"
BR2_TOOLCHAIN_EXTERNAL_GCC_14=y
BR2_TOOLCHAIN_EXTERNAL_HEADERS_6_18=y
BR2_TOOLCHAIN_EXTERNAL_CUSTOM_GLIBC=y
# BR2_TOOLCHAIN_EXTERNAL_INET_RPC is not set
BR2_PACKAGE_OVERRIDE_FILE="$(BR2_EXTERNAL_LINUX_BSP_PATH)/board/ti/am62x/local.mk"
BR2_TOOLCHAIN_EXTERNAL_CXX=y
BR2_TOOLCHAIN_EXTERNAL_OPENMP=y
BR2_DL_DIR="$(TOPDIR)/dl"
# BR2_GLOBAL_PATCH_DIR="$(BR2_EXTERNAL_LINUX_BSP_PATH)/board/ti/common/patches"
# BR2_DOWNLOAD_FORCE_CHECK_HASHES is not set
BR2_TARGET_GENERIC_HOSTNAME="am625"
BR2_TARGET_GENERIC_ISSUE=""
BR2_ROOTFS_DEVICE_CREATION_DYNAMIC_MDEV=y
BR2_ROOTFS_OVERLAY="$(BR2_EXTERNAL_LINUX_BSP_PATH)/board/ti/am62x/rootfs-overlay"
BR2_ROOTFS_POST_BUILD_SCRIPT="$(BR2_EXTERNAL_LINUX_BSP_PATH)/board/ti/am62x/post-build-ti.sh"
BR2_ROOTFS_POST_IMAGE_SCRIPT="$(BR2_EXTERNAL_LINUX_BSP_PATH)/board/ti/am62x/post-image-h200.sh"
BR2_ROOTFS_POST_BUILD_SCRIPT_ARGS="-d k3-am625-sk.dtb"
BR2_LINUX_KERNEL=y
BR2_LINUX_KERNEL_CUSTOM_GIT=y
BR2_LINUX_KERNEL_CUSTOM_REPO_URL="file://$(TOPDIR)/../linux/ti-linux-kernel-6.18.13"
BR2_LINUX_KERNEL_CUSTOM_REPO_VERSION="HEAD"
BR2_LINUX_KERNEL_USE_CUSTOM_CONFIG=y
BR2_LINUX_KERNEL_CUSTOM_CONFIG_FILE="$(BR2_EXTERNAL_LINUX_BSP_PATH)/board/ti/am62x/linux/am62x_defconfig"
BR2_LINUX_KERNEL_IMAGEGZ=y
BR2_LINUX_KERNEL_DTS_SUPPORT=y
BR2_LINUX_KERNEL_INTREE_DTS_NAME="ti/k3-am625-sk"
BR2_H200_DTB_SK=y
BR2_PACKAGE_BUSYBOX_CONFIG="$(BR2_EXTERNAL_LINUX_BSP_PATH)/board/ti/am62x/busybox/am62x_defconfig"
BR2_PACKAGE_BUSYBOX_SHOW_OTHERS=y
BR2_PACKAGE_K3CONF=y
BR2_PACKAGE_DROPBEAR=y
BR2_TARGET_ROOTFS_CPIO=y
BR2_TARGET_ROOTFS_CPIO_GZIP=y
BR2_ROOTFS_SKELETON_CUSTOM=y
BR2_ROOTFS_SKELETON_CUSTOM_PATH="$(BR2_EXTERNAL_LINUX_BSP_PATH)/board/ti/am62x/initramfs"
BR2_TARGET_ROOTFS_INITRAMFS=y
BR2_TARGET_ARM_TRUSTED_FIRMWARE=y
BR2_TARGET_ARM_TRUSTED_FIRMWARE_CUSTOM_GIT=y
BR2_TARGET_ARM_TRUSTED_FIRMWARE_CUSTOM_REPO_URL="https://github.com/ARM-software/arm-trusted-firmware.git"
BR2_TARGET_ARM_TRUSTED_FIRMWARE_CUSTOM_REPO_VERSION="76500ceaeefcda967d8a1f4e30bb04f9fe0425a2"
BR2_TARGET_ARM_TRUSTED_FIRMWARE_PLATFORM="k3"
BR2_TARGET_ARM_TRUSTED_FIRMWARE_TARGET_BOARD="lite"
BR2_TARGET_ARM_TRUSTED_FIRMWARE_BL32_OPTEE=y
BR2_TARGET_ARM_TRUSTED_FIRMWARE_ADDITIONAL_VARIABLES="K3_PM_SYSTEM_SUSPEND=1"
BR2_TARGET_OPTEE_OS=y
BR2_TARGET_OPTEE_OS_CUSTOM_GIT=y
BR2_TARGET_OPTEE_OS_CUSTOM_REPO_URL="https://github.com/OP-TEE/optee_os.git"
BR2_TARGET_OPTEE_OS_CUSTOM_REPO_VERSION="f2a7ad0638aeff5243593b33cc56ad064cae7615"
BR2_TARGET_OPTEE_OS_NEEDS_PYTHON_CRYPTOGRAPHY=y
BR2_TARGET_OPTEE_OS_PLATFORM="k3-am62x"
BR2_TARGET_OPTEE_OS_ADDITIONAL_VARIABLES="CFG_TEE_CORE_LOG_LEVEL=1"
BR2_TARGET_TI_K3_R5_LOADER=y
BR2_TARGET_TI_K3_R5_LOADER_CUSTOM_GIT=y
BR2_TARGET_TI_K3_R5_LOADER_CUSTOM_REPO_URL="file://$(TOPDIR)/../uboot/ti-u-boot-2025.10"
BR2_TARGET_TI_K3_R5_LOADER_CUSTOM_REPO_VERSION="HEAD"
BR2_TARGET_TI_K3_R5_LOADER_BOARD_DEFCONFIG="am62x_evm_r5"
BR2_TARGET_TI_K3_R5_LOADER_CONFIG_FRAGMENT_FILES="$(BR2_EXTERNAL_LINUX_BSP_PATH)/board/ti/am62x/uboot-fragment.config"
BR2_TARGET_TI_K3_R5_LOADER_TIBOOT3_BIN="tiboot3-am62x-gp-evm.bin"
BR2_TARGET_UBOOT=y
BR2_TARGET_UBOOT_BUILD_SYSTEM_KCONFIG=y
BR2_TARGET_UBOOT_CUSTOM_GIT=y
BR2_TARGET_UBOOT_CUSTOM_REPO_URL="file://$(TOPDIR)/../uboot/ti-u-boot-2025.10"
BR2_TARGET_UBOOT_CUSTOM_REPO_VERSION="HEAD"
BR2_TARGET_UBOOT_BOARD_DEFCONFIG="am62x_evm_a53"
BR2_TARGET_UBOOT_NEEDS_DTC=y
BR2_TARGET_UBOOT_NEEDS_OPENSSL=y
BR2_TARGET_UBOOT_NEEDS_ATF_BL31=y
BR2_TARGET_UBOOT_USE_BINMAN=y
# BR2_TARGET_UBOOT_FORMAT_BIN is not set
BR2_TARGET_UBOOT_FORMAT_IMG=y
BR2_TARGET_UBOOT_SPL=y
BR2_TARGET_UBOOT_SPL_NAME="tispl.bin"
BR2_TARGET_UBOOT_CUSTOM_MAKEOPTS="TEE=$(BINARIES_DIR)/tee-pager_v2.bin"
BR2_PACKAGE_HOST_DOSFSTOOLS=y
BR2_PACKAGE_HOST_GENIMAGE=y
BR2_PACKAGE_HOST_MTOOLS=y
```

## configs/ti_am62x_sdk_defconfig
```kconfig
BR2_aarch64=y
BR2_TOOLCHAIN_BUILDROOT_VENDOR="ca53"
BR2_PACKAGE_HOST_LINUX_HEADERS_CUSTOM_6_18=y
BR2_TOOLCHAIN_BUILDROOT_CXX=y
BR2_GCC_ENABLE_OPENMP=y
BR2_DL_DIR="/opt/buildroot/download"
BR2_GLOBAL_PATCH_DIR="$(BR2_EXTERNAL_LINUX_BSP_PATH)/board/ti/common/patches"
BR2_DOWNLOAD_FORCE_CHECK_HASHES=y
BR2_TARGET_GENERIC_HOSTNAME="am625"
BR2_TARGET_GENERIC_ISSUE=""
BR2_INIT_NONE=y
# BR2_TARGET_ENABLE_ROOT_LOGIN is not set
BR2_LINUX_KERNEL=y
BR2_LINUX_KERNEL_CUSTOM_TARBALL=y
BR2_LINUX_KERNEL_CUSTOM_TARBALL_LOCATION="http://192.168.18.254:4000/CSPD/ti-linux-kernel/archive/linux-12.00.00.08.tar.gz"
BR2_LINUX_KERNEL_USE_CUSTOM_CONFIG=y
BR2_LINUX_KERNEL_CUSTOM_CONFIG_FILE="$(BR2_EXTERNAL_LINUX_BSP_PATH)/board/ti/h200_100p_am625/linux/h200_100p_am625_defconfig"
BR2_LINUX_KERNEL_IMAGEGZ=y
BR2_LINUX_KERNEL_DTS_SUPPORT=y
BR2_LINUX_KERNEL_INTREE_DTS_NAME="ti/k3-am625-sk"
# BR2_PACKAGE_BUSYBOX is not set
BR2_PACKAGE_K3CONF=y
BR2_PACKAGE_DROPBEAR=y
# BR2_TARGET_ROOTFS_TAR is not set
BR2_PACKAGE_HOST_DOSFSTOOLS=y
BR2_PACKAGE_HOST_DTC=y
BR2_PACKAGE_HOST_GENIMAGE=y
BR2_PACKAGE_HOST_MTOOLS=y
```

## package/fwctl/Config.in
```kconfig
config BR2_PACKAGE_FWCTL
	bool "fwctl"
	depends on BR2_USE_MMU
	help
	  Install the userspace control utility for the RAW A/B firmware
	  metadata shared with U-Boot. It supports status, mark-good,
	  mark-bad, and rollback on the AM62x SD/MMC layout.
```

## package/paf/Config.in
```kconfig
config BR2_PACKAGE_PAF
	bool "paf"
	depends on BR2_LINUX_KERNEL
	depends on BR2_TOOLCHAIN_HAS_THREADS
	depends on BR2_USE_MMU
	help
	  PAF is a Linux peripheral access framework with a
	  Kconfig+CMake/Kbuild build system. It provides the PDM kernel
	  module, the shared PDI userspace library, UAPI headers, and
	  optional PDI tools such as pdebug and pdi_claim_test.

if BR2_PACKAGE_PAF

config BR2_PACKAGE_PAF_DEFCONFIG
	string "Kconfig defconfig to use"
	default ""
	help
	  Specify which PAF defconfig to load before building.
	  Product external trees should set this to a product-specific
	  PAF defconfig, for example imx6ull_modules_defconfig. Debug
	  images should use a defconfig that enables CONFIG_PDI,
	  CONFIG_PDEBUG, and CONFIG_PDI_CLAIM_TEST when board-side claim
	  validation is required.

config BR2_PACKAGE_PAF_PDI_BMC_REDFISH
	bool "Enable PAF PDI BMC Redfish dependencies"
	select BR2_PACKAGE_CJSON
	select BR2_PACKAGE_LIBCURL
	select BR2_PACKAGE_LIBCURL_FORCE_TLS
	select BR2_PACKAGE_LIBCURL_OPENSSL
	select BR2_PACKAGE_OPENSSL
	select BR2_PACKAGE_OPENSSL_FORCE_LIBOPENSSL
	help
	  Select this when the PAF defconfig enables CONFIG_PDI_BMC_REDFISH.
	  It provides libcurl and cJSON for the Redfish backend in libpdi.so.

config BR2_PACKAGE_PAF_PDI_BMC_IPMI
	bool "Enable PAF PDI BMC IPMI dependencies"
	select BR2_PACKAGE_FREEIPMI
	select BR2_PACKAGE_LIBGCRYPT if BR2_PACKAGE_LIBGPG_ERROR_ARCH_SUPPORTS
	help
	  Select this when the PAF defconfig enables CONFIG_PDI_BMC_IPMI.
	  It provides libfreeipmi for the IPMI backend in libpdi.so.
	  libgcrypt is selected when available so FreeIPMI can support IPMI 2.0
	  RMCP+ network sessions.

config BR2_PACKAGE_PAF_TB_MQTT_PUB
	bool "Enable PAF ThingsBoard MQTT app dependencies"
	depends on !BR2_STATIC_LIBS
	select BR2_PACKAGE_MOSQUITTO
	help
	  Select this when the PAF defconfig enables CONFIG_TB_MQTT_PUB.
	  It provides libmosquitto for the tb_mqtt_pub telemetry publisher.

config BR2_PACKAGE_PAF_FWCTL
	bool "Enable PAF firmware update app dependencies"
	depends on !BR2_STATIC_LIBS
	select BR2_PACKAGE_CA_CERTIFICATES
	select BR2_PACKAGE_DTC
	select BR2_PACKAGE_LIBCURL
	select BR2_PACKAGE_LIBCURL_FORCE_TLS
	select BR2_PACKAGE_LIBCURL_OPENSSL
	select BR2_PACKAGE_OPENSSL
	select BR2_PACKAGE_OPENSSL_FORCE_LIBOPENSSL
	help
	  Select this when the PAF defconfig enables CONFIG_FWCTL. It provides
	  libfdt, libcurl, and OpenSSL for FIT parsing, HTTP(S) downloads, and
	  SHA-256 verification.

config BR2_PACKAGE_PAF_FWCTL_FIT_SIGNATURE
	bool "Install fwctl FIT signature verifier"
	depends on BR2_PACKAGE_PAF_FWCTL
	select BR2_PACKAGE_UBOOT_TOOLS
	select BR2_PACKAGE_UBOOT_TOOLS_FIT_SUPPORT
	select BR2_PACKAGE_UBOOT_TOOLS_FIT_SIGNATURE_SUPPORT
	select BR2_PACKAGE_UBOOT_TOOLS_FIT_CHECK_SIGN
	help
	  Install fit_check_sign for fwctl configurations that require FIT
	  signature verification against a trusted key DTB.


choice
	prompt "Build type"
	default BR2_PACKAGE_PAF_BUILD_TYPE_RELEASE

config BR2_PACKAGE_PAF_BUILD_TYPE_RELEASE
	bool "Release"

config BR2_PACKAGE_PAF_BUILD_TYPE_DEBUG
	bool "Debug"

config BR2_PACKAGE_PAF_BUILD_TYPE_RELWITHDEBINFO
	bool "RelWithDebInfo"

endchoice

config BR2_PACKAGE_PAF_BUILD_TYPE
	string
	default "Release" if BR2_PACKAGE_PAF_BUILD_TYPE_RELEASE
	default "Debug" if BR2_PACKAGE_PAF_BUILD_TYPE_DEBUG
	default "RelWithDebInfo" if BR2_PACKAGE_PAF_BUILD_TYPE_RELWITHDEBINFO

config BR2_PACKAGE_PAF_INSTALL_HEADERS
	bool "Install development headers"
	default n
	help
	  Install development headers to $(STAGING_DIR)/usr/include/pdm/.
	  Only needed for packages that depend on PAF.

endif # BR2_PACKAGE_PAF

comment "PAF needs Linux kernel and a toolchain w/ threads, MMU"
	depends on !BR2_LINUX_KERNEL || !BR2_TOOLCHAIN_HAS_THREADS || \
		!BR2_USE_MMU
```
